## daplink2uart_bridge_zephyr/build/Kconfig/arch/Kconfig
```kconfig
# Load Zephyr Arch Kconfig descriptions.
osource "/Users/tedd/dev/Zephyr/zephyr/zephyr/arch/rx/Kconfig"
osource "/Users/tedd/dev/Zephyr/zephyr/zephyr/arch/x86/Kconfig"
osource "/Users/tedd/dev/Zephyr/zephyr/zephyr/arch/xtensa/Kconfig"
osource "/Users/tedd/dev/Zephyr/zephyr/zephyr/arch/sparc/Kconfig"
osource "/Users/tedd/dev/Zephyr/zephyr/zephyr/arch/riscv/Kconfig"
osource "/Users/tedd/dev/Zephyr/zephyr/zephyr/arch/posix/Kconfig"
osource "/Users/tedd/dev/Zephyr/zephyr/zephyr/arch/mips/Kconfig"
osource "/Users/tedd/dev/Zephyr/zephyr/zephyr/arch/arm64/Kconfig"
osource "/Users/tedd/dev/Zephyr/zephyr/zephyr/arch/arm/Kconfig"
osource "/Users/tedd/dev/Zephyr/zephyr/zephyr/arch/arc/Kconfig"
```

## daplink2uart_bridge_zephyr/build/Kconfig/boards/Kconfig.defconfig
```kconfig
# Load Zephyr board defconfig descriptions.
osource "/Users/tedd/dev/Zephyr/zephyr/zephyr/boards/nxp/frdm_mcxa153/Kconfig.defconfig"
```

## daplink2uart_bridge_zephyr/build/Kconfig/boards/Kconfig.frdm_mcxa153
```kconfig
# Load board Kconfig descriptions.
osource "/Users/tedd/dev/Zephyr/zephyr/zephyr/boards/nxp/frdm_mcxa153/Kconfig.frdm_mcxa153"
```

## daplink2uart_bridge_zephyr/build/Kconfig/boards/Kconfig.sysbuild
```kconfig
# Load Sysbuild board Kconfig descriptions.
osource "/Users/tedd/dev/Zephyr/zephyr/zephyr/boards/nxp/frdm_mcxa153/Kconfig.sysbuild"
```
